## diagnostics/s3-bod-selector/sdkconfig.defaults
```kconfig
CONFIG_FREERTOS_UNICORE=y
CONFIG_ESP_DEFAULT_CPU_FREQ_MHZ_160=y
# CONFIG_ESP_BROWNOUT_DET is not set
# CONFIG_SECURE_BOOT is not set
# CONFIG_SECURE_FLASH_ENC_ENABLED is not set
# CONFIG_SECURE_ENABLE_TEE is not set
```
